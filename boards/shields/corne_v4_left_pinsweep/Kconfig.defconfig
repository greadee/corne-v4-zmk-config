## boards/shields/corne_v4_left_pinsweep/Kconfig.defconfig
```kconfig
if SHIELD_CORNE_V4_LEFT_PINSWEEP

config ZMK_KEYBOARD_NAME
    default "Corne V4"

config ZMK_SPLIT_ROLE_CENTRAL
    default y

config ZMK_SPLIT
    default y

endif
```

## boards/shields/corne_v4_left_pinsweep/Kconfig.shield
```kconfig
config SHIELD_CORNE_V4_LEFT_PINSWEEP
    def_bool $(shields_list_contains,corne_v4_left_pinsweep)
```

## boards/shields/corne_v4_left_rowinputs/Kconfig.defconfig
```kconfig
if SHIELD_CORNE_V4_LEFT_ROWINPUTS

config ZMK_KEYBOARD_NAME
    default "Corne V4"

config ZMK_SPLIT_ROLE_CENTRAL
    default y

config ZMK_SPLIT
    default y

endif
```

## boards/shields/corne_v4_left_rowinputs/Kconfig.shield
```kconfig
config SHIELD_CORNE_V4_LEFT_ROWINPUTS
    def_bool $(shields_list_contains,corne_v4_left_rowinputs)
```

## config/west.yml
```yaml
manifest:
  defaults:
    revision: v0.3
  remotes:
    - name: zmkfirmware
      url-base: https://github.com/zmkfirmware
    - name: aym1607
      url-base: https://github.com/AYM1607
    # Additional modules containing boards/shields/custom code can be listed here as well
    # See https://docs.zephyrproject.org/3.2.0/develop/west/manifest.html#projects
  projects:
    - name: zmk
      remote: zmkfirmware
      import: app/west.yml
    - name: zmk-driver-azoteq-iqs5xx
      remote: aym1607
      revision: 27321f0232b50f0af31eb27ff97d539933467ea4
      path: modules/zmk-driver-azoteq-iqs5xx
  self:
    path: config
```
