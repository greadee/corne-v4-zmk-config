#include "../corne_v4_left_extcols/corne_v4_left_extcols.dtsi"

&default_transform {
    rows = <10>;
    map = <
        RC(0,0) RC(0,1) RC(0,2) RC(0,3) RC(1,0) RC(1,1)  RC(1,2) RC(1,3) RC(2,0) RC(2,1) RC(2,2) RC(2,3)
        RC(3,0) RC(3,1) RC(3,2) RC(3,3) RC(4,0) RC(4,1)  RC(4,2) RC(4,3) RC(5,0) RC(5,1) RC(5,2) RC(5,3)
        RC(6,0) RC(6,1) RC(6,2) RC(6,3) RC(7,0) RC(7,1)  RC(7,2) RC(7,3) RC(8,0) RC(8,1) RC(8,2) RC(8,3)
                                RC(9,0) RC(9,1) RC(9,2)  RC(9,3) RC(0,10) RC(1,10)
    >;
};

&kscan0 {
    diode-direction = "col2row";
    row-gpios = <
        &gpio0 22 (GPIO_ACTIVE_LOW | GPIO_PULL_UP)
        &gpio0 24 (GPIO_ACTIVE_LOW | GPIO_PULL_UP)
        &gpio1 0  (GPIO_ACTIVE_LOW | GPIO_PULL_UP)
        &gpio0 11 (GPIO_ACTIVE_LOW | GPIO_PULL_UP)
        &gpio0 29 (GPIO_ACTIVE_LOW | GPIO_PULL_UP)
        &gpio0 31 (GPIO_ACTIVE_LOW | GPIO_PULL_UP)
        &gpio1 7  (GPIO_ACTIVE_LOW | GPIO_PULL_UP)
        &gpio0 6  (GPIO_ACTIVE_LOW | GPIO_PULL_UP)
        &gpio0 17 (GPIO_ACTIVE_LOW | GPIO_PULL_UP)
        &gpio0 20 (GPIO_ACTIVE_LOW | GPIO_PULL_UP)
    >;
    col-gpios = <
        &gpio0 2  GPIO_ACTIVE_LOW
        &gpio1 15 GPIO_ACTIVE_LOW
        &gpio1 13 GPIO_ACTIVE_LOW
        &gpio1 11 GPIO_ACTIVE_LOW
    >;
};
