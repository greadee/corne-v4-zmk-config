#include "corne_v4_left.dtsi"

&kscan0 {
    col-gpios = <
        &gpio0 11 GPIO_ACTIVE_LOW
        &gpio1 0  GPIO_ACTIVE_LOW
        &gpio0 24 GPIO_ACTIVE_LOW
        &gpio0 22 GPIO_ACTIVE_LOW
        &gpio0 29 GPIO_ACTIVE_LOW
        &gpio0 31 GPIO_ACTIVE_LOW
    >;
};
