#include "corne_v4_right.dtsi"

&kscan0 {
    col-gpios = <
        &gpio1 11 GPIO_ACTIVE_LOW
        &gpio1 13 GPIO_ACTIVE_LOW
        &gpio1 15 GPIO_ACTIVE_LOW
        &gpio0 2  GPIO_ACTIVE_LOW
    >;
};
