
/ {
    chosen {
        zmk,kscan = &kscan0;
        zmk,matrix-transform = &matrix_transform;
    };
};
/ { 
    kscan0: kscan {
        compatible = "zmk,kscan-gpio-matrix";
        diode-direction = "col2row";

        row-gpios = <
            &gpio0 22 GPIO_ACTIVE_HIGH 
            &gpio0 24 GPIO_ACTIVE_HIGH 
            &gpio1 0 GPIO_ACTIVE_HIGH 
            &gpio0 11 GPIO_ACTIVE_HIGH 
        >;

        col-gpios = <
            &gpio0 31 GPIO_ACTIVE_HIGH 
            &gpio0 29 GPIO_ACTIVE_HIGH 
            &gpio0 2 GPIO_ACTIVE_HIGH 
            &gpio1 15 GPIO_ACTIVE_HIGH 
            &gpio1 13 GPIO_ACTIVE_HIGH 
            &gpio1 11 GPIO_ACTIVE_HIGH 

        >;
    };
};
/ {
    matrix_transform: matrix_transform {
        compatible = "zmk,matrix-transform";

        columns = <6>;
        rows = <4>;

        map = <
             0  1  2  3  4  5
             6  7  8  9 10 11
            12 13 14 15 16 17
            18 19 20 -1 -1 -1
        >;
    };
};
