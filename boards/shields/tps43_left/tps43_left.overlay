/ {
    split_inputs {
        #address-cells = <1>;
        #size-cells = <0>;

        tps43_split: tps43_split@0 {
            compatible = "zmk,input-split";
            reg = <0>;
        };
    };

    tps43_listener {
        compatible = "zmk,input-listener";
        device = <&tps43_split>;
    };
};
