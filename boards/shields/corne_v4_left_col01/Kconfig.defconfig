## boards/shields/corne_v4_left_col01/Kconfig.defconfig
```kconfig
if SHIELD_CORNE_V4_LEFT_COL01

config ZMK_KEYBOARD_NAME
    default "Corne V4"

config ZMK_SPLIT_ROLE_CENTRAL
    default y

endif

if SHIELD_CORNE_V4_LEFT_COL01

config ZMK_SPLIT
    default y

endif
```

## boards/shields/corne_v4_left_col01/Kconfig.shield
```kconfig
config SHIELD_CORNE_V4_LEFT_COL01
    def_bool $(shields_list_contains,corne_v4_left_col01)
```

## boards/shields/corne_v4_left_fullgrid/Kconfig.defconfig
```kconfig
if SHIELD_CORNE_V4_LEFT_FULLGRID

config ZMK_KEYBOARD_NAME
    default "Corne V4"

config ZMK_SPLIT_ROLE_CENTRAL
    default y

endif

if SHIELD_CORNE_V4_LEFT_FULLGRID

config ZMK_SPLIT
    default y

endif
```

## boards/shields/corne_v4_left_fullgrid/Kconfig.shield
```kconfig
config SHIELD_CORNE_V4_LEFT_FULLGRID
    def_bool $(shields_list_contains,corne_v4_left_fullgrid)
```

## boards/shields/corne_v4_left_misscols/Kconfig.shield
```kconfig
config SHIELD_CORNE_V4_LEFT_MISSCOLS
    def_bool $(shields_list_contains,corne_v4_left_misscols)
```

## boards/shields/corne_v4_left_row45/Kconfig.shield
```kconfig
config SHIELD_CORNE_V4_LEFT_ROW45
    def_bool $(shields_list_contains,corne_v4_left_row45)
```
